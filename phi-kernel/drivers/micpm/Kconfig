## phi-kernel/drivers/micpm/Kconfig
```kconfig
if MK1OM || (ML1OM && MK1OM_TEST) 
config	MIC_PM 
	bool "Power Management for MIC devices"
	help
	  Include the PM driver for Intel MIC devices
	  If in doubt, say N.
if MIC_PM
config	MIC_CPUFREQ
	bool "cpufreq driver for MIC devices"
	depends on MIC_PM
	select CPU_FREQ
	select CPU_FREQ_TABLE
	select CPU_FREQ_DEBUG
	select CPU_FREQ_DEFAULT_GOV_USERSPACE
	select CPU_FREQ_GOV_USERSPACE
	select CPU_FREQ_GOV_ONDEMAND
	select CPU_FREQ_STAT
	select CPU_FREQ_STAT_DETAILS
	help
	  Include the cpufreq driver for Intel MIC devices
	  If in doubt, say N.						  		  		  

config	MIC_CPUIDLE
	bool "cpuidle driver for MIC devices"
	depends on MIC_PM
	help
	  Include the cpuidle driver for Intel MIC devices
	  If in doubt, say N.
endif	  	
endif
```

## phi-kernel/net/9p/Kconfig
```kconfig
#
# 9P protocol configuration
#

menuconfig NET_9P
	depends on NET
	tristate "Plan 9 Resource Sharing Support (9P2000)"
	help
	  If you say Y here, you will get experimental support for
	  Plan 9 resource sharing via the 9P2000 protocol.

	  See <http://v9fs.sf.net> for more information.

	  If unsure, say N.

if NET_9P

config NET_9P_VIRTIO
	depends on VIRTIO
	tristate "9P Virtio Transport"
	help
	  This builds support for a transports between
	  guest partitions and a host partition.

config NET_9P_RDMA
	depends on INET && INFINIBAND && INFINIBAND_ADDR_TRANS
	tristate "9P RDMA Transport (Experimental)"
	help
	  This builds support for an RDMA transport.

config NET_9P_PRB
	depends on PCI_RING_BUFFER && NET_9P_ZERO_COPY
	tristate "9P PCI ring buffer (PRB) Transport"
	help
	  This builds support for an PCI ring buffer (PRB) transport.

config NET_9P_DEBUG
	bool "Debug information"
	help
	  Say Y if you want the 9P subsystem to log debug information.

config NET_9P_ZERO_COPY
	bool "Zero copy"
	help
	  Say Y if you want to enable zero copy transport
endif
```

## phi-kernel/net/pcnlink/Kconfig
```kconfig
#
# pcnlink (PCIe Cloud Network) to host
#
config NET_PCN_LINK
       depends on NET_9P_PRB && PCI_RING_BUFFER
       tristate "pci ring buffer link over PCIe bus"
       default m
```
